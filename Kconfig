## Kconfig
```kconfig
mainmenu "Project purpleK2 kernel"

menu "Filesystems"

choice FILE_OWNER_GID_SETTING_TYPE
	prompt "File owner and group ID setting method"
	default FILE_OWNER_GID_SETTING_SYSV
	help
		Choose the method used to set the owner and group ID of newly created files

config FILE_OWNER_GID_SETTING_SYSV
	bool "System V style"
	help
		Sets the owner and group ID of newly created files to the effective user ID and effective group ID of the creating process

config FILE_OWNER_GID_SETTING_BSD
	bool "BSD style"
	help
		Sets the owner ID of newly created files to the effective user ID of the creating process, and the group ID to that of the parent directory

endchoice # FILE_OWNER_GID_SETTING_TYPE

config DEVFS_ENABLE
    bool "Enable Device Filesystem (DevFS)"
    default y
    help
      Enable the pseudo filesystem for devices 

menu "DevFS options"
depends on DEVFS_ENABLE

config DEVFS_MOUNT
    string "DevFS mount path"
    default "/dev"
    help
      Where to mount the DevFS pseudo filesystem

endmenu # DevFS options

menu "ProcFS options"
config PROCFS_MOUNT
    string "ProcFS mount path"
    default "/proc"
    help
      Where to mount the DevFS pseudo filesystem

endmenu # DevFS options

endmenu # Filesystems

menu "Advanced debugging"

config PMM_DEBUG
	bool "Enable PMM debugging"
	default n
	help
		Enables detailed debugging when PMM (de)allocations happen. NOTE: this makes paging init way slower than usual.

config PAGING_DEBUG
	bool "Enable paging debugging"
	default n
	help
		Outputs info when paging-related operations occur

config VMM_DEBUG
	bool "Enable VMM debugging"
	default n
	help
		Enables detailed debugging when VMM (de)allocations happen

config SCHED_DEBUG
	bool "Enable scheduler debugging"
	default n
	help
		Outputs detailed info about scheduler-related operations

config PCI_DEBUG
	bool "Enable PCI debugging"
	default n
	help
		Outputs detailed info about PCI initialization and PCI devices operations

config PCIE_DEBUG
	bool "Enable PCIe debugging"
	default n
	help
		Outputs detailed info about PCIe initialization and PCIe devices operations
	
endmenu # Advanced debugging

menu "Scheduling"

config SCHED_NUM_MLFQ_QUEUES
	int "Number of MLFQ queues"
	default 4
	range 2 10
	help
		Specifies the number of priority levels (queues) in the Multi-Level Feedback Queue scheduler

config SCHED_MLFQ_BOOST_INTERVAL
	int "MLFQ boost interval (ticks)"
	default 100
	range 10 1000
	help
		Specifies the interval (in ticks) at which all threads are boosted to the highest

config SCHED_TIMER_INTERVAL_MS
	int "Scheduler timer interval (ms)"
	default 10
	range 1 100
	help
		Specifies the timer interrupt interval for the scheduler in milliseconds

config SCHED_TLS_MAX_SIZE_PAGES
	int "Maximum TLS size (in pages)"
	default 16
	range 1 64
	help
		Specifies the maximum size of Thread-Local Storage (TLS) in pages

endmenu # Scheduling

config KERNEL_CMDLINE_MAX_OPS
	int "Maximum amount of kernel commandline arguments"
	default 64
	range 8 128
	help
		Specifies the maximum amount of kernel commandline arguments that can be used in the kernel (like init_proc="...")

config KERNEL_INIT_PROC_MAX_ARGS
	int "Maximum amount of arguments that can be passed to init process"
	default 64
	range 8 128
	help
		Specifies the maximum amount of arguments that can be passed to the init process

config KERNEL_MAX_GROUPS
	int "Maximum amount of groups a user can be in"
	default 32
	range 8 128
	help
		Specifies the maximum amount of groups a user can be in
```
